## X10Overclock/drivers/oc/Kconfig
```kconfig
#
# X10OC module configuration
#

config X10_OVERCLOCK
	tristate "X10 overclock"
	help
	  Say Y here if you want to build an overclock module for X10

	  If unsure, say N.

	  To compile this module, choose M here: the
	  module will be called x10oc.
```

## X10Undervolt/drivers/uv_x10/Kconfig
```kconfig
#
# X10UV module configuration
#

config X10_UNDERVOLT
	tristate "X10 undervolt"
	help
	  Say Y here if you want to build an undervolt module for X10

	  If unsure, say N.

	  To compile this module, choose M here: the
	  module will be called x10uv.
```
